/*
 * ssd1306.c
 *
 * Created: 22-Dec-18 11:55:55 AM
 * Author: Ranul Deepanayake
 * 128* 64 bits, divided into 8 pages ((16 bytes* 8 bytes)/8). 1 page= 16 bytes (128 bits).  
 */ 

#include "ssd1306.h"

/*
The display buffer stored in the host microcontroller. 
Uses 1024 Bytes of RAM. 1 Byte represents one page.
*/
uint8_t ssd1306_gddram_buffer[1024]= {
	0x00, 0x00, 0x00, 0x00, 0x00, 0x00, 0x00, 0x00, 0x00, 0x00, 0x00, 0x00, 0x00, 0x00, 0x00, 0x00, 0x00, 0x00, 0x00, 0x00, 0x00, 0x00, 0x00, 0x00, 0x00, 0x00, 
	0x00, 0x00, 0x00, 0x00, 0x00, 0x00, 0x00, 0x00, 0x00, 0x00, 0x00, 0x00, 0x00, 0x00, 0x00, 0x00, 0x00, 0x00, 0x00, 0x00, 0x00, 0x00, 0x00, 0x00, 0x00, 0x00, 
	0x00, 0x00, 0x00, 0x00, 0x00, 0x00, 0x00, 0x00, 0x00, 0x00, 0x00, 0x00, 0x00, 0x00, 0x00, 0x00, 0x00, 0x00, 0x00, 0x00, 0x00, 0x00, 0x00, 0x00, 0x00, 0x00, 
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	0x00, 0x00, 0x00, 0x00, 0x00, 0x00, 0x00, 0x00, 0x00, 0x00
};

void ssd1306Initialize(){
	/*
	SSD1306 OLED display initialization sequence.
	Uses values stored in flash.
	*/
	i2cDelayedStart(SSD1306_SLAVE_ADDRESS, I2C_WRITE);
	i2cWrite(SSD1306_CONTROL_BYTE_COMMAND_STREAM);
	for(uint8_t i= 0; i< 24; i++){
		i2cWrite(pgm_read_byte(&(ssd1306_initialization_values[i])));	//Read the array of values stored in flash.
	}
	i2cStop();	
}

void ssd1306SendCommand(uint8_t command){
	/*
	Send a single command byte to the display.
	*/
	i2cDelayedStart(SSD1306_SLAVE_ADDRESS, I2C_WRITE);
	i2cWrite(SSD1306_CONTROL_BYTE_COMMAND_SINGLE);
	i2cWrite(command);
	i2cStop();
}

void ssd1306SendData(uint8_t data){
	/*
	Send a single data byte to the GDDRAM.
	*/
	i2cDelayedStart(SSD1306_SLAVE_ADDRESS, I2C_WRITE);
	i2cWrite(SSD1306_CONTROL_BYTE_DATA_SINGLE);
	i2cWrite(data);
	i2cStop();
}

uint8_t ssd1306LocationXY(uint8_t x, uint8_t y){
	/*
	Set the X and Y axes in the GDDRAM.
	Doesn't use the local frame buffer.
	*/
	
	if(x> (SSD1306_WIDTH- 1) || x< 0 || y> (SSD1306_HEIGHT- 1) || y< 0){ 
		return SSD1306_COORDINATE_OUT_OF_RANGE;		//Deal with out of range pixel coordinates.
	}
	y< 8 ? (y= 0) : (y= y/8);						//Deal with divide by zero.
	i2cDelayedStart(SSD1306_SLAVE_ADDRESS, I2C_WRITE);
	i2cWrite(SSD1306_CONTROL_BYTE_COMMAND_STREAM);	
	i2cWrite(SSD1306_DISPLAY_COLUMN_ADDRESS);		//Column address.
	i2cWrite(x);		//Value.
	i2cWrite(x);		//Value.
	i2cWrite(SSD1306_DISPLAY_PAGE_ADDRESS);		//Page address.
	i2cWrite(y);		//Value.
	i2cWrite(y);		//Value.
	i2cStop();
	return SSD1306_SUCCESS;
}

uint8_t ssd1306DrawPixel(uint8_t x, uint8_t y){
	/*
	Draw a single pixel on the display according to a X and Y axes.
	Doesn't use the local frame buffer.
	*/
	if(ssd1306LocationXY(x, y)!= SSD1306_SUCCESS){
		return SSD1306_COORDINATE_OUT_OF_RANGE;
	}
	
	y== 0 ? (y= y) : (y%= (SSD1306_HEIGHT/8));	//Check and skip if '0'.
	uint8_t base= 2, exponent= y, result= 1;
	if(y> 0){									//Get the display page value in the power of two. Skip if value is '0'.
		while(exponent!= 0){
			result*= base;
			--exponent;
		}
	}
	else{
		result= 0x01;		
	}
	
	i2cDelayedStart(SSD1306_SLAVE_ADDRESS, I2C_WRITE);
	i2cWrite(SSD1306_CONTROL_BYTE_DATA_SINGLE);
	i2cWrite(result);
	i2cStop();
	return SSD1306_SUCCESS;
}

void ssd1306SelectWholeBuffer(){
	/*
	Helper function to select the whole GDDRAM.
	Doesn't use the local frame buffer.
	*/
	i2cDelayedStart(SSD1306_SLAVE_ADDRESS, I2C_WRITE);
	i2cWrite(SSD1306_CONTROL_BYTE_COMMAND_STREAM);
	i2cWrite(SSD1306_DISPLAY_COLUMN_ADDRESS);				//Column address.
	i2cWrite(0);				//Value.
	i2cWrite(SSD1306_WIDTH- 1);	//Value.
	i2cWrite(SSD1306_DISPLAY_PAGE_ADDRESS);				//Page address.
	i2cWrite(0);				//Value.
	i2cWrite(SSD1306_HEIGHT- 1);//Value.
	i2cStop();
}

void ssd1306ClearDisplay(){
	/*
	Zero fill the display.
	Uses the local frame buffer.
	*/
	for(uint16_t i= 0; i< SSD1306_GDDRAM_SIZE; i++){
		ssd1306_gddram_buffer[i]= 0x00;		//Zero fill the local frame buffer.
	}
	ssd1306TransferBuffer();
}

void ssd1306TransferBuffer(){
	/*
	Fill the GDDRAM with the local frame buffer.
	*/
	ssd1306SelectWholeBuffer();
	i2cDelayedStart(SSD1306_SLAVE_ADDRESS, I2C_WRITE);
	i2cWrite(SSD1306_CONTROL_BYTE_DATA_STREAM);
	for(uint16_t i= 0; i< SSD1306_GDDRAM_SIZE; i++){
		i2cWrite(ssd1306_gddram_buffer[i]);		
	}
	i2cStop();
}

void ssd1306TestFont(){
	/*
	Tests the font collection stored in flash memory.
	Uses the local frame buffer.
	*/
	uint16_t buffer_pointer= 0;			//GDDRAM location pointer.
	uint8_t characters_per_line= 0;
	
	for(uint8_t character= 32; character< 127; character++){
		for(uint8_t page= 0; page< 6; page++){
			ssd1306_gddram_buffer[buffer_pointer] = pgm_read_byte(&(ssd1306_font[character][page]));
			buffer_pointer++;
		}
			characters_per_line++;
			if(characters_per_line== 21){	//Handle horizontal overflow.
				buffer_pointer+= 2;
				characters_per_line= 0;
			}
	}
}

uint8_t ssd1306Print(char *string, uint8_t x, uint8_t y){
	/*
	Sends an array of characters to the local display buffer starting from the specified X and Y pixel coordinates.
	The local buffer has to pushed to the GDDRAM using the 'ssd1306TransferBuffer()' function.
	Column addresses are rounded off according to the font byte size to prevent display edge overflow.
	*/
	uint8_t x_div= 0; 
	uint16_t buffer_pointer= 0;		//GDDRAM location pointer.
	uint8_t characters_per_line= 0;
	uint16_t array_size= 0;
	uint8_t ascii_value= 0;
	
	if(x> (SSD1306_WIDTH- 1) || x< 0 || y> (SSD1306_HEIGHT- 1) || y< 0){
		return SSD1306_COORDINATE_OUT_OF_RANGE;		//Deal with out of range pixel coordinates.
	}
	y< 8 ? (y= 0) : (y= y/8);		//Deal with divide by zero.
	y+= 1; 
	x_div= x/6;				//Round off x axis to 6 pages to prevent display edge overflow. 
	x= x_div* 6;
	
	buffer_pointer= ((y* 128)- 128)+ x;		//Map the coordinates with the array index.
	
	while((ascii_value= *(string+ array_size))!= 0x00){
		array_size++;
	}
	
	for(uint8_t character_count= 0; character_count< array_size; character_count++){
		for(uint8_t page= 0; page< 6; page++){
			ssd1306_gddram_buffer[buffer_pointer] = pgm_read_byte(&(ssd1306_font[(uint8_t)*(string+ character_count)][page]));
			buffer_pointer++;
		}
		characters_per_line++;
		if(characters_per_line== 21){	//Handle horizontal overflow***************** Complete.
			buffer_pointer+= 2;
			characters_per_line= 0;
		}
	}
	return SSD1306_SUCCESS;
}

void ssd1306FillBuffer(uint8_t pattern){
	/*
	Fill the local frame buffer with the specified byte pattern.
	'memset' is used.
	*/
	memset(ssd1306_gddram_buffer, pattern, SSD1306_GDDRAM_SIZE);
}

void ssd1306SetContrast(uint8_t contrast){
	/*
	Control the display contrast. Values between 0x00- 0xFF are accepted.
	*/
	i2cDelayedStart(SSD1306_SLAVE_ADDRESS, I2C_WRITE);
	i2cWrite(SSD1306_CONTROL_BYTE_COMMAND_STREAM); 
	i2cWrite(SSD1306_DISPLAY_CONTRAST);
	i2cWrite(contrast);
	i2cStop();
}

void ssd1306SetCharSize(){
	//Under development.
}

