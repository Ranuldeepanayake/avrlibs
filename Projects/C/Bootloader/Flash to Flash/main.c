/*
 * EEPROM to Flash.c
 *
 * Created: 05-Aug-24 7:11:12 PM
 * Author : Ranul Deepanayake
 * A boot loader program which writes a blink program's instructions from RAM to the EEPROM and reads and writes it back from the EEPROM to the application flash section.
 * The boot loader program resides in the boot loader flash section and the reset interrupt vector is set to the boot loader section start. 
 * The boot loader program has been written to the flash word address 0x3800.
 */ 

#include <avr/io.h>
#include <avr/boot.h>
#include <avr/interrupt.h>
#include <avr/pgmspace.h>
#include <string.h>
#include <stdlib.h>
#include <util/delay.h>
#include "uart.h"

/*
Page size: 64 words/128 bytes
Total pages: 256
Total word address: 16384
Total byte address: 32768
Page address: 13:6
Word address: 0:5
*/
//Page size in words.
#define PAGE_SIZE_WORDS 64
//Page size in bytes.
#define PAGE_SIZE_BYTES (PAGE_SIZE_WORDS * 2)
//Byte address 8192; 4096th word.
#define PAGE_START_ADDRESS 0	

void writePage(uint16_t page_start_address);

/*
The blink program instructions.
90 words/180 bytes/1.4 pages
*/
PROGMEM const uint8_t blink_program[180] = {
	0x0C, 0x94, 0x34, 0x00, 0x0C, 0x94, 0x3E, 0x00, 0x0C, 0x94, 0x3E, 0x00, 0x0C, 0x94, 0x3E, 0x00,
	0x0C, 0x94, 0x3E, 0x00, 0x0C, 0x94, 0x3E, 0x00, 0x0C, 0x94, 0x3E, 0x00, 0x0C, 0x94, 0x3E, 0x00,
	0x0C, 0x94, 0x3E, 0x00, 0x0C, 0x94, 0x3E, 0x00, 0x0C, 0x94, 0x3E, 0x00, 0x0C, 0x94, 0x3E, 0x00,
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	0xF8, 0x94, 0xFF, 0xCF
};

uint8_t cache[180];
char temp[10];
uint16_t flash_address = 0;

int main(void)
{		
	//uartSet(UART_BAUD_RATE(115200), UART_DATA_SIZE_8, UART_PARITY_NONE, UART_STOP_BITS_1);
	//uartPrintLn("Init>");
	
	//Write the blink program's instructions from FLASH to the RAM temporarily.
	//memset(cache, 0, 180);
	for(uint16_t byte = 0; byte < 180; byte++){
		
		//uartPrintLn("Reading byte");
		cache[byte] = pgm_read_byte_near(&blink_program[byte]);
		itoa(cache[byte], temp, 16);
		//uartPrint(temp); uartPrint(" ");
		//memset(temp, 0, 10);
		//_delay_ms(10);
	}
	
	//Write a page in the application flash section. Data from the EEPROM is loaded within the function itself.
	for(uint32_t page = PAGE_START_ADDRESS; page <= (PAGE_SIZE_BYTES * 2); page += PAGE_SIZE_BYTES){
		writePage(page);		
	}
	
	//Jump to the newly loaded program in the application flash section.
	__asm__("jmp 0x0000");
	
    while (1) 
    {
		
    }
}

void writePage(uint16_t page_start_address){
	uint16_t data_temp = 0;
	
	cli();									//Disable interrupts.
	boot_page_erase(page_start_address);	//Erase the page to be written (byte address of the page start).
	boot_spm_busy_wait();					//Wait till the erase is complete.
	
	//Fill the page write buffer with bytes, not words.
	for(uint8_t i = 0; i < PAGE_SIZE_WORDS; i += 2){		//Increment two addresses since data is written byte-wise even though addressing is done word-wise (??).
			
		data_temp = cache[flash_address];							//Convert to little endian when passing to boot_page_fill(). LSB first and MSB second.
		flash_address++;									//Increment the EEEPROM address to read the MSB.	
			
		data_temp |= ((cache[flash_address]) << 8);					//Convert to little endian when passing to boot_page_fill(). LSB first and MSB second.
		flash_address++;									//Increment the EEEPROM address to read the next cycle's LSB.
		
		boot_page_fill(page_start_address + i, data_temp); //LS byte address of a word address and a data word.
		
	}
	
	boot_page_write(page_start_address);	//Write data to the flash (byte address of the page start).
	boot_spm_busy_wait();					//Wait till the write is complete.
	
	boot_rww_enable();						//Re-enable reading the RWW section after programming the RWW section (required when executing code in the application section).
	sei();									//Re-enable interrupts.
}

//PROGMEM const uint8_t program_1[] = {
	//0x0C, 0x94, 0x34, 0x00, 0x0C, 0x94, 0x3E, 0x00, 0x0C, 0x94, 0x3E, 0x00, 0x0C, 0x94, 0x3E, 0x00,
	//0x0C, 0x94, 0x3E, 0x00, 0x0C, 0x94, 0x3E, 0x00, 0x0C, 0x94, 0x3E, 0x00, 0x0C, 0x94, 0x3E, 0x00,
	//0x0C, 0x94, 0x3E, 0x00, 0x0C, 0x94, 0x3E, 0x00, 0x0C, 0x94, 0x3E, 0x00, 0x0C, 0x94, 0x3E, 0x00,
	//0x0C, 0x94, 0x3E, 0x00, 0x0C, 0x94, 0x3E, 0x00, 0x0C, 0x94, 0x3E, 0x00, 0x0C, 0x94, 0x3E, 0x00,
	//0x0C, 0x94, 0x3E, 0x00, 0x0C, 0x94, 0x3E, 0x00, 0x0C, 0x94, 0x3E, 0x00, 0x0C, 0x94, 0x3E, 0x00,
	//0x0C, 0x94, 0x3E, 0x00, 0x0C, 0x94, 0x3E, 0x00, 0x0C, 0x94, 0x3E, 0x00, 0x0C, 0x94, 0x3E, 0x00,
	//0x0C, 0x94, 0x3E, 0x00, 0x0C, 0x94, 0x3E, 0x00, 0x11, 0x24, 0x1F, 0xBE, 0xCF, 0xEF, 0xD8, 0xE0,
	//0xDE, 0xBF, 0xCD, 0xBF, 0x0E, 0x94, 0x40, 0x00, 0x0C, 0x94, 0x58, 0x00, 0x0C, 0x94, 0x00, 0x00,
	//0x25, 0x9A, 0x90, 0xE2, 0x2F, 0xEF, 0x39, 0xE6, 0x88, 0xE1, 0x21, 0x50, 0x30, 0x40, 0x80, 0x40,
	//0xE1, 0xF7, 0x00, 0xC0, 0x00, 0x00, 0x85, 0xB1, 0x89, 0x27, 0x85, 0xB9, 0x2F, 0xEF, 0x39, 0xE6,
	//0x88, 0xE1, 0x21, 0x50, 0x30, 0x40, 0x80, 0x40, 0xE1, 0xF7, 0x00, 0xC0, 0x00, 0x00, 0xEA, 0xCF,
	//0xF8, 0x94, 0xFF, 0xCF
//};